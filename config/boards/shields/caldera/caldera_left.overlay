// Config specifically for the left side
#include "caldera.dtsi" // The shared dtsi file is included in the overlay

// Make sure to use the same label of the kscan node in the dtsi
&kscan0 {
	col-gpios
		= <&gpio0 20 GPIO_ACTIVE_HIGH>
		, <&gpio0 22 GPIO_ACTIVE_HIGH>
		, <&gpio0 24 GPIO_ACTIVE_HIGH>
		, <&gpio1 00 GPIO_ACTIVE_HIGH>
		, <&gpio0 11 GPIO_ACTIVE_HIGH>
		, <&gpio0 17 GPIO_ACTIVE_HIGH>
		;
};