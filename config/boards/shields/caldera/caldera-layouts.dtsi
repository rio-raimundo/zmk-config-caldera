// Defines the layouts - needs to be in a separate file to be used with ZMK Studio. Imported in caldera.overlay

/ {
    physical_layout0: physical_layout_0 { // First physical layout, use different naming for other layouts
        compatible = "zmk,physical-layout";
        display-name = "Default Layout";
        kscan = <&kscan0>; // Label of the kscan node, optional if all layouts use the same. Can also be set in chosen if it doesn't change...
        transform = <&default_transform>; // Label of the matrix transform for this layout
    };

	// Just defines which layout is chosen by default, I think? 
	chosen {
        zmk,physical-layout = &physical_layout0;
    };
};