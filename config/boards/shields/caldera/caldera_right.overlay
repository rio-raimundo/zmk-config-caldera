// Config specifically for the right side
#include "caldera.dtsi" // The shared dtsi file is included in the overlay

// Add an offset to the default_transform defined in the dtsi, I guess so the columns count as columns 6-11 rather than 0-5
&default_transform { 
    col-offset = <6>;
};

// Make sure to use the same label of the kscan node in the dtsi
&kscan0 {
	// The gpios for the right side are flipped relative to the left side, just because of how the board works
	col-gpios
		= <&gpio0 17 GPIO_ACTIVE_HIGH>
		, <&gpio0 11 GPIO_ACTIVE_HIGH>
		, <&gpio1 00 GPIO_ACTIVE_HIGH>
		, <&gpio0 24 GPIO_ACTIVE_HIGH>
		, <&gpio0 22 GPIO_ACTIVE_HIGH>
		, <&gpio0 20 GPIO_ACTIVE_HIGH>
		;
};